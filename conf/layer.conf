## conf/layer.conf
```bitbake
# We have a conf and classes directory, add to BBPATH
BBPATH .= ":${LAYERDIR}"

# We have recipes-* directories, add to BBFILES
BBFILES += "${LAYERDIR}/recipes-*/*/*.bb \
            ${LAYERDIR}/recipes-*/*/*.bbappend"

BBFILE_COLLECTIONS += "meta-toolbox"
BBFILE_PATTERN_meta-toolbox = "^${LAYERDIR}/"
BBFILE_PRIORITY_meta-toolbox = "6"

LAYERDEPENDS_meta-toolbox = "core"
LAYERSERIES_COMPAT_meta-toolbox = "dunfell"
```
